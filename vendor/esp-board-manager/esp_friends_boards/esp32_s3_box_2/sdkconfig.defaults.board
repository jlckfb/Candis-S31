## vendor/esp-board-manager/esp_friends_boards/esp32_s3_box_2/sdkconfig.defaults.board
```kconfig
CONFIG_ESP_DEFAULT_CPU_FREQ_MHZ_240=y
CONFIG_ESPTOOLPY_FLASHMODE_QIO=y
CONFIG_ESPTOOLPY_FLASHFREQ_80M=y
CONFIG_ESPTOOLPY_FLASHSIZE_16MB=y
CONFIG_SPIRAM=y
CONFIG_SPIRAM_MODE_OCT=y
CONFIG_SPIRAM_SPEED_80M=y

CONFIG_CODEC_ES8311_SUPPORT=n
CONFIG_CODEC_ES7210_SUPPORT=n
CONFIG_CODEC_ES7243_SUPPORT=n
CONFIG_CODEC_ES7243E_SUPPORT=n
CONFIG_CODEC_ES8156_SUPPORT=n
CONFIG_CODEC_AW88298_SUPPORT=n
CONFIG_CODEC_ES8389_SUPPORT=y
CONFIG_CODEC_ES8374_SUPPORT=n
CONFIG_CODEC_ES8388_SUPPORT=n
CONFIG_CODEC_TAS5805M_SUPPORT=n
CONFIG_CODEC_ZL38063_SUPPORT=n
CONFIG_CODEC_CJC8910_SUPPORT=n
```

## vendor/esp-board-manager/esp_friends_boards/esp_hi/sdkconfig.defaults.board
```kconfig
CONFIG_ESPTOOLPY_FLASHSIZE_4MB=y

#
# Audio Codec Device Configuration
#
CONFIG_CODEC_ES8311_SUPPORT=n
CONFIG_CODEC_ES7210_SUPPORT=n
CONFIG_CODEC_ES7243_SUPPORT=n
CONFIG_CODEC_ES7243E_SUPPORT=n
CONFIG_CODEC_ES8156_SUPPORT=n
CONFIG_CODEC_AW88298_SUPPORT=n
CONFIG_CODEC_ES8389_SUPPORT=n
CONFIG_CODEC_ES8374_SUPPORT=n
CONFIG_CODEC_ES8388_SUPPORT=n
CONFIG_CODEC_TAS5805M_SUPPORT=n
CONFIG_CODEC_ZL38063_SUPPORT=n
CONFIG_CODEC_CJC8910_SUPPORT=n
CONFIG_CODEC_DUMMY_SUPPORT=y
CONFIG_CODEC_DATA_ADC_SUPPORT=y
# end of Audio Codec Device Configuration
```
