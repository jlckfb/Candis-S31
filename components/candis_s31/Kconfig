## examples/esp-idf/player/sdkconfig.defaults
```kconfig
# Candis-S31 full-screen MJPEG player baseline.
# Uses QIO 80 MHz Flash and 250 MHz Octal PSRAM validated on EVT1.
CONFIG_IDF_TARGET="esp32s31"
CONFIG_COMPILER_OPTIMIZATION_PERF=y
CONFIG_LOG_DEFAULT_LEVEL_INFO=y
CONFIG_ESP_CONSOLE_UART_DEFAULT=y
CONFIG_ESP_CONSOLE_SECONDARY_NONE=y

# Report peripheral failures instead of aborting on them.
CONFIG_BSP_ERROR_CHECK=n

CONFIG_ESPTOOLPY_FLASHSIZE_16MB=y
CONFIG_ESPTOOLPY_FLASHMODE_QIO=y
CONFIG_ESPTOOLPY_FLASHFREQ_80M=y

# Single 8 MB app partition (no OTA); see partitions.csv.
CONFIG_PARTITION_TABLE_CUSTOM=y
CONFIG_PARTITION_TABLE_CUSTOM_FILENAME="partitions.csv"
CONFIG_PARTITION_TABLE_FILENAME="partitions.csv"

# PSRAM: octal mode, 250 MHz (EVT1-validated setting).
CONFIG_SPIRAM=y
CONFIG_SPIRAM_MODE_OCT=y
CONFIG_SPIRAM_SPEED_250M=y
CONFIG_SPIRAM_MEMTEST=y

# Move the general heap into PSRAM.
CONFIG_SPIRAM_USE_MALLOC=y
CONFIG_SPIRAM_MALLOC_ALWAYSINTERNAL=16384
CONFIG_SPIRAM_MALLOC_RESERVE_INTERNAL=32768
CONFIG_FREERTOS_TASK_CREATE_ALLOW_EXT_MEM=y

# Display: QSPI 48 MHz, LVGL PARTIAL, two internal-DMA buffers.
CONFIG_BSP_LCD_PIXEL_CLOCK_MHZ=48
CONFIG_BSP_LCD_TE_SYNC=y
CONFIG_LV_COLOR_DEPTH_16=y
CONFIG_LV_DEF_REFR_PERIOD=10
CONFIG_BSP_LCD_DRAW_BUF_HEIGHT=48
CONFIG_BSP_LCD_DRAW_BUF_DOUBLE=y

# LVGL draw settings.
CONFIG_LV_USE_PPA=n
CONFIG_LV_DRAW_BUF_ALIGN=64
CONFIG_LV_FONT_MONTSERRAT_16=y

# 1 ms tick.
CONFIG_FREERTOS_HZ=1000

# app_main stack.
CONFIG_ESP_MAIN_TASK_STACK_SIZE=8192

# Keep LVGL allocations in a bounded private pool.
CONFIG_LV_MEM_SIZE_KILOBYTES=64

# Fonts.
CONFIG_LV_FONT_SOURCE_HAN_SANS_SC_16_CJK=y
CONFIG_LV_FONT_DEFAULT_MONTSERRAT_16=y
CONFIG_LV_FONT_MONTSERRAT_24=y
CONFIG_LV_USE_TINY_TTF=y
CONFIG_LV_TINY_TTF_FILE_SUPPORT=n
CONFIG_LV_TINY_TTF_CACHE_GLYPH_CNT=128
CONFIG_LV_TINY_TTF_CACHE_KERNING_CNT=256

# FATFS long filenames and code page for SD card file names.
CONFIG_FATFS_LFN_HEAP=y
CONFIG_FATFS_MAX_LFN=255
CONFIG_FATFS_CODEPAGE_936=y
CONFIG_FATFS_API_ENCODING_UTF_8=y
CONFIG_FATFS_USE_FASTSEEK=y

# Offline media pipeline: AVI/MP4 with hardware MJPEG and PCM/AAC audio.
CONFIG_ESP_PLAYER_ENABLE_AUDIO=y
CONFIG_ESP_PLAYER_ENABLE_VIDEO=y
CONFIG_ESP_PLAYER_ENABLE_FILE_IO=y
# CONFIG_ESP_PLAYER_ENABLE_HTTP_IO is not set
# CONFIG_ESP_PLAYER_ENABLE_HLS_IO is not set

CONFIG_EXTRACTOR_CUSTOM_SUPPORT=n
CONFIG_AUDIO_ES_EXTRACTOR_SUPPORT=n
CONFIG_WAV_EXTRACTOR_SUPPORT=n
CONFIG_MP4_EXTRACTOR_SUPPORT=y
CONFIG_TS_EXTRACTOR_SUPPORT=n
CONFIG_OGG_EXTRACTOR_SUPPORT=n
CONFIG_AVI_EXTRACTOR_SUPPORT=y
CONFIG_CAF_EXTRACTOR_SUPPORT=n
CONFIG_FLV_EXTRACTOR_SUPPORT=n
CONFIG_EXTRACTOR_HELPER_FILE_IO_CACHE_SIZE=32768

CONFIG_VIDEO_DECODER_SW_H264_SUPPORT=y
CONFIG_ESP_H264_DECODER_IRAM=y
CONFIG_ESP_H264_DUAL_TASK=n
CONFIG_VIDEO_DECODER_SW_MJPEG_SUPPORT=n
CONFIG_VIDEO_DECODER_HW_MJPEG_SUPPORT=y
CONFIG_VIDEO_ENCODER_HW_H264_SUPPORT=n
CONFIG_VIDEO_ENCODER_SW_H264_SUPPORT=n
CONFIG_VIDEO_ENCODER_HW_MJPEG_SUPPORT=n
CONFIG_VIDEO_ENCODER_SW_MJPEG_SUPPORT=n

CONFIG_AUDIO_DECODER_AAC_SUPPORT=y
CONFIG_AUDIO_DECODER_PCM_SUPPORT=y
CONFIG_AUDIO_DECODER_MP3_SUPPORT=n
CONFIG_AUDIO_DECODER_G711_SUPPORT=n
CONFIG_AUDIO_DECODER_G722_SUPPORT=n
CONFIG_AUDIO_DECODER_AMRNB_SUPPORT=n
CONFIG_AUDIO_DECODER_AMRWB_SUPPORT=n
CONFIG_AUDIO_DECODER_FLAC_SUPPORT=n
CONFIG_AUDIO_DECODER_VORBIS_SUPPORT=n
CONFIG_AUDIO_DECODER_OPUS_SUPPORT=n
CONFIG_AUDIO_DECODER_ADPCM_SUPPORT=n
CONFIG_AUDIO_DECODER_ALAC_SUPPORT=n
CONFIG_AUDIO_DECODER_SBC_SUPPORT=n
CONFIG_AUDIO_DECODER_LC3_SUPPORT=n
CONFIG_AUDIO_SIMPLE_DEC_WAV_SUPPORT=n
CONFIG_AUDIO_SIMPLE_DEC_M4A_SUPPORT=y
CONFIG_AUDIO_SIMPLE_DEC_TS_SUPPORT=n
CONFIG_AUDIO_SIMPLE_DEC_OGG_SUPPORT=n

CONFIG_ESP_VIDEO_RENDER_LVGL_BACKEND_SUPPORT=n
CONFIG_ESP_VIDEO_RENDER_WIDGET_SUPPORT=y
CONFIG_ESP_VIDEO_RENDER_TEXT_WIDGET_SUPPORT=n
CONFIG_VIDEO_RENDER_MEASURE_ENABLE=y
```

## examples/esp-idf/rtc/main/Kconfig.projbuild
```kconfig
menu "RTC example"

    config EXAMPLE_RTC_SET_ON_BOOT
        bool "Set the RTC to a fixed time on boot"
        default n
        help
            When enabled, the example writes 2026-01-01 00:00:00 to the
            RX8130CE before reading it back. Keep disabled to preserve the
            battery-backed clock.

endmenu
```

## examples/esp-idf/wifi/main/Kconfig.projbuild
```kconfig
menu "WiFi example"

    config EXAMPLE_WIFI_SSID
        string "WiFi SSID to connect to (empty = scan only)"
        default ""

    config EXAMPLE_WIFI_PASSWORD
        string "WiFi password"
        default ""

endmenu
```

## firmware/camera_test/main/Kconfig.projbuild
```kconfig
menu "Candis-S31 Camera Test"
    config CAMERA_TEST_USE_UYVY
        bool "Use UYVY sensor output and software conversion"
        default n
        help
            Select the sensor's UYVY path and convert it to RGB565 in the
            application, bypassing a module-specific RGB565 packing fault.

    config CAMERA_TEST_ESP32_CAMERA_OV5640
        bool "Configure OV5640 with Espressif esp32-camera"
        depends on CAMERA_TEST_USE_UYVY
        default y
        help
            Run the unmodified OV5640 sensor implementation from
            espressif/esp32-camera 2.1.7 after VIDIOC_S_FMT. The ESP32-S31
            DVP receiver remains provided by esp_video.

    config CAMERA_TEST_SERIAL_FRAME_DUMP
        bool "Dump one raw and converted frame over the console"
        depends on CAMERA_TEST_USE_UYVY
        default y
        help
            After the automatic cycles, write one source frame followed by
            its PPA RGB565 output as length-delimited binary console data.

    config CAMERA_TEST_AUTOFOCUS
        bool "Run OV5640 embedded single-shot autofocus"
        default y
        help
            After STREAMON, load the sensor's embedded autofocus firmware,
            rebuild the center zone, run one focus cycle, and verify its
            per-zone result through the public Candis-S31 BSP API.

    config CAMERA_TEST_DISPLAY_PATTERN
        bool "Display a fixed four-quadrant pattern"
        default n
        help
            Replace camera frames with a fixed pattern to isolate the display
            and LVGL path from sensor data.
    config CAMERA_TEST_SENSOR_COLOR_BAR
        bool "Enable the sensor color-bar test pattern"
        default n
        help
            Enable the OV5640 internal color bar before streaming to isolate
            the DVP receiver from the analog image path.
    config CAMERA_TEST_NATIVE_TABLE_ONLY
        bool "Keep the native OV5640 format table after VIDIOC_S_FMT"
        help
            Skip the Candis post-format ISP/output override so the sensor's
            exact boot-time format table remains unchanged.

    config CAMERA_TEST_FAST_SHUTTER
        bool "Force manual 1/60 s exposure"
        default n
        help
            Hold OV5640 exposure at 418 lines (16.68 ms at the board's
            47.5 Mpixel/s rate) and analog gain at 6x for motion-smear diagnosis.


    config CAMERA_TEST_SENSOR_PCLK_INVERT
        bool "Invert sensor PCLK polarity"
        default n
        help
            Set OV5640 register 0x4740 bit 5 low for a sensor-side
            sampling-edge experiment.
    config CAMERA_TEST_RECEIVER_PCLK_INVERT
        bool "Invert receiver PCLK sampling"
        default n
        help
            Set the S31 LCD_CAM CAM_CLK_INV bit after STREAMON for a
            receiver-side sampling-edge experiment.


    config CAMERA_TEST_UYVY_CTRL_3F
        bool "Use OV5640 UYVY control value 0x3F"
        default n
        help
            Select the Linux-compatible UYVY format control value for a
            module-level output-format comparison.
    config CAMERA_TEST_CYCLES
        int "Automatic start/stop cycles"
        default 3
        range 1 20
        help
            Number of complete camera start, capture, and stop cycles run at
            boot. More than one cycle checks driver teardown and reinitialization.

    config CAMERA_TEST_FRAMES
        int "Frames per cycle"
        default 6
        range 3 100
        help
            Number of frames captured and checked in each cycle.

    config CAMERA_TEST_BOOT_DELAY_MS
        int "Boot delay before camera test (ms)"
        default 5000
        range 0 10000
        help
            Delay before board and camera initialization so a serial monitor
            can attach after reset.

endmenu
```

## vendor/esp-board-manager/esp_friends_boards/candis_s31/sdkconfig.defaults.board
```kconfig
CONFIG_ESP_DEFAULT_CPU_FREQ_MHZ_320=y
CONFIG_ESPTOOLPY_FLASHMODE_QIO=y
CONFIG_ESPTOOLPY_FLASHFREQ_80M=y
CONFIG_ESPTOOLPY_FLASHSIZE_16MB=y

CONFIG_SPIRAM=y
CONFIG_SPIRAM_MODE_OCT=y
CONFIG_SPIRAM_SPEED_250M=y
CONFIG_SPIRAM_USE_CAPS_ALLOC=y

CONFIG_CODEC_ES8311_SUPPORT=n
CONFIG_CODEC_ES7210_SUPPORT=n
CONFIG_CODEC_ES7243_SUPPORT=n
CONFIG_CODEC_ES7243E_SUPPORT=n
CONFIG_CODEC_ES8156_SUPPORT=n
CONFIG_CODEC_AW88298_SUPPORT=n
CONFIG_CODEC_ES8389_SUPPORT=y
CONFIG_CODEC_ES8374_SUPPORT=n
CONFIG_CODEC_ES8388_SUPPORT=n
CONFIG_CODEC_TAS5805M_SUPPORT=n
CONFIG_CODEC_ZL38063_SUPPORT=n
CONFIG_CODEC_CJC8910_SUPPORT=n

CONFIG_CAMERA_OV5640=y
CONFIG_CAMERA_OV5640_AUTO_DETECT_DVP_INTERFACE_SENSOR=y
CONFIG_CAM_CTRL_SPI_ENABLE=n
CONFIG_ESP_VIDEO_ENABLE_DVP_VIDEO_DEVICE=y
CONFIG_ESP_VIDEO_ENABLE_MIPI_CSI_VIDEO_DEVICE=n
CONFIG_ESP_VIDEO_ENABLE_SPI_VIDEO_DEVICE=n
CONFIG_ESP_VIDEO_ENABLE_USB_UVC_VIDEO_DEVICE=n
```

## vendor/esp-bsp/bsp/candis_s31/Kconfig
```kconfig
menu "Board Support Package (Candis-S31)"

    config BSP_ERROR_CHECK
        bool "Enable error check in BSP"
        default y
        help
            Abort on BSP initialization errors. Disable this option when the
            application needs to handle and report initialization failures.

    menu "I2C"
        config BSP_I2C_NUM
            int "Main I2C controller"
            default 0
            range 0 2
            help
                Controller used by the main bus on GPIO33 and GPIO34.

        config BSP_LP_I2C_NUM
            int "Low-power I2C controller"
            default 1
            range 0 2
            help
                Controller used by TG28_SW and RX8130CE on GPIO6 and GPIO7.

        config BSP_I2C_INTERNAL_PULLUPS
            bool "Enable internal I2C pull-ups"
            default n
            help
                External pull-ups are fitted on the board. Enable this only
                for controlled diagnostics.
    endmenu

    menu "Display"
        config BSP_LCD_PIXEL_CLOCK_MHZ
            int "CO5300 QSPI clock (MHz)"
            default 48
            range 10 50
            help
                CO5300 datasheet limits the 4-wire QSPI write clock to 50 MHz.
                48 MHz is the highest frequency the ESP32-S31 SPI clock
                generator produces exactly (BBPLL 480 MHz / 10) within that
                limit. Values above 40 MHz route over the GPIO matrix on
                this pinout; validate signal integrity on new board spins.

        config BSP_LCD_TE_SYNC
            bool "Synchronize LVGL flushes with the panel TE signal"
            default y
            help
                Registers the CO5300 tearing-effect edge (GPIO16) with
                esp_lvgl_port. In the default LVGL PARTIAL path only the first
                flush of each refresh cycle waits for TE; later chunks are
                pipelined without another frame-period wait. Disabling this
                removes TE gating while retaining PARTIAL rendering.

        config BSP_LCD_DRAW_BUF_HEIGHT
            int "Display transfer buffer height (lines)"
            default 48
            range 10 460
            help
                Height of each internal-DMA LVGL PARTIAL draw buffer and the
                matching QSPI maximum transfer. The 48-line default is the
                measured 60 Hz local / 30 Hz full-screen baseline and keeps
                internal RAM pressure below the earlier 80-line setting.

        config BSP_LCD_DRAW_BUF_DOUBLE
            bool "Use two LVGL draw buffers"
            default y
            help
                Allocate two internal-DMA PARTIAL buffers so LVGL rendering
                can overlap the QSPI transfer. Disable only when internal RAM
                is constrained and revalidate display throughput afterward.

        config BSP_LCD_DIRECT_MODE
            bool "Full-frame PSRAM DIRECT rendering with per-cycle TE-gated flush"
            default n
            help
                Optional esp_lvgl_port full-frame path for applications that
                require a persistent framebuffer. The validated default is
                PARTIAL double buffering, which has lower local-update latency;
                leave this disabled unless the DIRECT path is tested separately.
    endmenu

    menu "Storage"
        config BSP_SD_FORMAT_ON_MOUNT_FAIL
            bool "Format SD card when mounting fails"
            default n

        config BSP_SD_MOUNT_POINT
            string "SD card mount point"
            default "/sdcard"

        config BSP_SPIFFS_FORMAT_ON_MOUNT_FAIL
            bool "Format SPIFFS when mounting fails"
            default n

        config BSP_SPIFFS_MOUNT_POINT
            string "SPIFFS mount point"
            default "/spiffs"

        config BSP_SPIFFS_PARTITION_LABEL
            string "Partition label of SPIFFS"
            default "storage"

        config BSP_SPIFFS_MAX_FILES
            int "Max files supported for SPIFFS VFS"
            default 5
    endmenu

    menu "Audio"
        config BSP_I2S_NUM
            int "I2S controller"
            default 0
            range 0 2
            help
                Controller used by the ES8389 codec interface.
    endmenu

    menu "Camera"
        config BSP_CAMERA_XCLK_USE_LEDC
            bool "Generate the camera XCLK with LEDC"
            default y
            help
                Keep this enabled. The esp_video DVP clock path
                (esp_cam_ctlr_dvp_output_clock, called by init_dvp_clk_func
                in esp_video_init.c whenever xclk_io >= 0 and xclk_freq > 0)
                only supports integer clock dividers, and no ESP32-S31 CAM
                controller clock source (PLL_F160M, XTAL, APLL) is an integer
                multiple of the 24 MHz the OV5640 register tables require
                (160 % 24 = 16, 40 % 24 = 16). esp_cam_ctlr_dvp_output_clock
                hard-fails with "calculated frequency divider is not integer"
                and aborts esp_video_init_with_flags() before sensor
                detection. APLL could provide 96 MHz = 4 x 24 MHz, but
                esp_video hardcodes CAM_CLK_SRC_DEFAULT (PLL_F160M), so the
                controller path cannot be fixed without patching official
                components. With this option enabled the BSP drives the
                24 MHz XCLK from a fractional LEDC channel and passes
                xclk_io=GPIO_NUM_NC / xclk_freq=0 to esp_video, which skips
                the failing controller clock path entirely. Disable only for
                a diagnostic experiment with a controller-driven XCLK at a
                frequency that evenly divides PLL_F160M (e.g. 20 MHz).

        config BSP_CAMERA_XCLK_LEDC_CH
            int "LEDC channel used for camera XCLK"
            default 2
            range 0 7
            help
                Only used when BSP_CAMERA_XCLK_USE_LEDC is enabled.
    endmenu

    menu "RGB LED"
        choice BSP_LED_RGB_BACKEND
            prompt "LED strip backend"
            default BSP_LED_RGB_BACKEND_RMT

            config BSP_LED_RGB_BACKEND_RMT
                bool "RMT"

            config BSP_LED_RGB_BACKEND_SPI
                bool "SPI"
        endchoice
    endmenu

endmenu
```
